/ {
	amba_pl: amba_pl {
		ranges;
		compatible = "simple-bus";
		#address-cells = <1>;
		#size-cells = <1>;
		firmware-name = "Game_Datapath_V2.bit.bin";
		clocking0: clocking0 {
			compatible = "xlnx,fclk";
			assigned-clocks = <&clkc 15>;
			assigned-clock-rates = <100000000>;
			#clock-cells = <0>;
			clock-output-names = "fabric_clk";
			clocks = <&clkc 15>;
		};
		pattern_hdmi_axi_0: pattern_hdmi_axi@40000000 {
			xlnx,rable = <0>;
			compatible = "xlnx,pattern-hdmi-axi-1.0";
			status = "okay";
			clock-names = "CLK" , "S_AXI_ACLK";
			xlnx,ip-name = "pattern_hdmi_axi";
			xlnx,edk-iptype = "PERIPHERAL";
			reg = <0x40000000 0x1000>;
			clocks = <&clkc 15>, <&clkc 15>;
			xlnx,name = "pattern_hdmi_axi_0";
		};
	};
};
